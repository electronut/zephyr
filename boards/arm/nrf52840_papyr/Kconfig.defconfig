## boards/arm/nrf52840_papyr/Kconfig.defconfig
```kconfig
# Kconfig - Electronut Labs Papyr board configuration
#
# Copyright (c) 2018 Electronut Labs
#
# SPDX-License-Identifier: Apache-2.0

if BOARD_NRF52840_PAPYR

config BOARD
	default "nrf52840_papyr"

if USB

config USB_NRF52840
	default y

config USB_DEVICE_STACK
	default y

endif # USB

if IEEE802154

config IEEE802154_NRF5
	default y

endif # IEEE802154

endif # BOARD_NRF52840_PAPYR
```

## drivers/sensor/si7006/Kconfig
```kconfig
#
# Copyright (c) 2019 Vaishali Pathak <vaishali@electronut.in>
#
# SPDX-License-Identifier: Apache-2.0
#

config SI7006
	bool "SI7006 Temperature and Humidity Sensor"
	depends on (I2C && HAS_DTS_I2C)
	help
	  Enable I2C-based driver for SI7006 Temperature and Humidity Sensor.
```
